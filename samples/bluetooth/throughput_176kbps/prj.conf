## prj.conf
```kconfig
CONFIG_CONSOLE_SUBSYS=y
CONFIG_CONSOLE_HANDLER=y
CONFIG_CONSOLE_GETCHAR=y

CONFIG_BT_DEVICE_NAME="Nordic_Throughput"
CONFIG_BT=y
CONFIG_BT_DEBUG_LOG=y
CONFIG_BT_SMP=y
CONFIG_BT_PERIPHERAL=y
CONFIG_BT_CENTRAL=y
CONFIG_BT_MAX_CONN=2

CONFIG_HEAP_MEM_POOL_SIZE=2048

CONFIG_BT_RX_BUF_LEN=255
CONFIG_BT_GATT_CLIENT=y
CONFIG_BT_ATT_TX_MAX=10
CONFIG_BT_ATT_PREPARE_COUNT=2
CONFIG_BT_CONN_TX_MAX=10
CONFIG_BT_L2CAP_TX_BUF_COUNT=10
CONFIG_BT_L2CAP_TX_MTU=247
CONFIG_BT_L2CAP_RX_MTU=247
CONFIG_BT_L2CAP_DYNAMIC_CHANNEL=y
CONFIG_BT_CTLR_PHY_2M=y
CONFIG_BT_CTLR_RX_BUFFERS=2
CONFIG_BT_CTLR_TX_BUFFERS=10
CONFIG_BT_CTLR_TX_BUFFER_SIZE=251
CONFIG_BT_CTLR_DATA_LENGTH_MAX=251
CONFIG_ASSERT=n
```

## src/main.c
```c
/*
 * Copyright (c) 2018 Nordic Semiconductor ASA
 *
 * SPDX-License-Identifier: LicenseRef-BSD-5-Clause-Nordic
 * In order to evaluate the performance of BLEX, it is a throughput measurement code that was modified and brought from Nordic SDK. 
 * In particular, among the 4 slaves, each slave generate different amount of traffic by changing the data interval.
 */

#include <kernel.h>
#include <console/console.h>
#include <sys/printk.h>
#include <string.h>
#include <stdlib.h>
#include <zephyr/types.h>

#include <stddef.h>
#include <errno.h>
#include <zephyr.h>

#include <bluetooth/bluetooth.h>
#include <bluetooth/crypto.h>
#include <bluetooth/conn.h>
#include <bluetooth/gatt.h>
#include <bluetooth/hci.h>
#include <bluetooth/uuid.h>
#include "throughput.h"
#include "gatt_dm.h"

#define DEVICE_NAME	CONFIG_BT_DEVICE_NAME
#define DEVICE_NAME_LEN (sizeof(DEVICE_NAME) - 1)
#define INTERVAL_MIN	0x140	/* 320 units, 400 ms */
#define INTERVAL_MAX	0x140	/* 320 units, 400 ms */

static volatile bool test_ready;
static struct bt_conn *default_conn;
bool start_flag= false;
static struct bt_conn *scan_conn;
static struct bt_gatt_throughput gatt_throughput;
static struct bt_gatt_exchange_params exchange_params;


#define sys_le16_to_cpu(val)(val)
static const struct bt_data ad[] = {
        BT_DATA_BYTES(BT_DATA_FLAGS, (BT_LE_AD_GENERAL | BT_LE_AD_NO_BREDR)),
        BT_DATA_BYTES(BT_DATA_UUID16_ALL, 0x0d, 0x18, 0x0f, 0x18, 0x0a, 0x18),
};

static const char img[][81] = {
#include "img.file"
};

static void exchange_func(struct bt_conn *conn, uint8_t att_err,
			  struct bt_gatt_exchange_params *params)
{
	struct bt_conn_info info = {0};
	int err;

	printk("MTU exchange %s\n", att_err == 0 ? "successful" : "failed");

	err = bt_conn_get_info(conn, &info);
	if (err){
		printk("Failed to get connection info %d\n", err);
		return;
	}

	uint32_t stamp = k_uptime_get_32();
	while(k_uptime_get_32()-stamp < 60000);
	if (info.role == BT_CONN_ROLE_SLAVE) {
		test_ready = true;
	}
}

static void discovery_complete(struct bt_gatt_dm *dm,
			       void *context)
{
	int err;
	struct bt_gatt_throughput *throughput = context;

	printk("Service discovery completed\n");

	bt_gatt_dm_data_print(dm);
	bt_gatt_throughput_handles_assign(dm, throughput);
	bt_gatt_dm_data_release(dm);

	exchange_params.func = exchange_func;

	err = bt_gatt_exchange_mtu(default_conn, &exchange_params);
	if (err) {
		printk("MTU exchange failed (err %d)\n", err);
	} else {
		printk("MTU exchange pending\n");
	}
}

static void discovery_service_not_found(struct bt_conn *conn,
					void *context)
{
	printk("Service not found\n");
}

static void discovery_error(struct bt_conn *conn,
			    int err,
			    void *context)
{
	printk("Error while discovering GATT database: (%d)\n", err);
}

struct bt_gatt_dm_cb discovery_cb = {
	.completed         = discovery_complete,
	.service_not_found = discovery_service_not_found,
	.error_found       = discovery_error,
};

static void connected(struct bt_conn *conn, uint8_t hci_err)
{
	struct bt_conn_info info = {0};
	int err;

	if (hci_err) {
		if (hci_err == BT_HCI_ERR_UNKNOWN_CONN_ID) {
			/* Canceled creating connection */
			return;
		}

		printk("Connection failed (err 0x%02x)\n", hci_err);
		return;
	}

	if (default_conn) {
		printk("Connection exists, disconnect second connection\n");
		bt_conn_disconnect(conn, BT_HCI_ERR_LOCALHOST_TERM_CONN);
		return;
	}

	default_conn = bt_conn_ref(conn);

	if (scan_conn) {
		if (scan_conn != conn) {
			/* Cancel creating master connection. */
			printk("Stop scanning for master connection\n");
			bt_conn_disconnect(scan_conn,
					   BT_HCI_ERR_LOCALHOST_TERM_CONN);
		}

		bt_conn_unref(scan_conn);
		scan_conn = NULL;
	}

	err = bt_conn_get_info(default_conn, &info);
	if (err) {
		printk("Failed to get connection info %d\n", err);
		return;
	}

	printk("Connected as %s\n",
	       info.role == BT_CONN_ROLE_MASTER ? "master" : "slave");
	printk("Conn. interval is %u units\n", info.le.interval);

	if (info.role == BT_CONN_ROLE_SLAVE) {
		err = bt_gatt_dm_start(default_conn,
				       BT_UUID_THROUGHPUT,
				       &discovery_cb,
				       &gatt_throughput);

		if (err) {
			printk("Discover failed (err %d)\n", err);
		}
	}
}
static bool eir_found(struct bt_data *data, void *user_data)
{
        bt_addr_le_t *addr = user_data;
        int i;

        printk("[AD]: %u data_len %u\n", data->type, data->data_len);

        switch (data->type) {
        case BT_DATA_UUID16_SOME:
        case BT_DATA_UUID16_ALL:
                if (data->data_len % sizeof(uint16_t) != 0U) {
                        printk("AD malformed\n");
                        return true;
                }

                for (i = 0; i < data->data_len; i += sizeof(uint16_t)) {
                        struct bt_le_conn_param *param;
                        struct bt_uuid *uuid;
                        uint16_t u16;
                        int err;

                        memcpy(&u16, &data->data[i], sizeof(u16));
                        uuid = BT_UUID_DECLARE_16(sys_le16_to_cpu(u16));
                        if (bt_uuid_cmp(uuid, BT_UUID_HRS)) {
                                continue;
                        }

                        err = bt_le_scan_stop();
                        if (err) {
                                printk("Stop LE scan failed (err %d)\n", err);
                                continue;
                        }

                        param = BT_LE_CONN_PARAM_DEFAULT;
                        err = bt_conn_le_create(addr, BT_CONN_LE_CREATE_CONN,
                                                param, &default_conn);
                        if (err) {
                                printk("Create conn failed (err %d)\n", err);
                        }

                        return false;
                }
        }

        return true;
}

static void device_found(const bt_addr_le_t *addr, uint8_t rssi, uint8_t type,
                         struct net_buf_simple *ad)
{
        char dev[BT_ADDR_LE_STR_LEN];

        bt_addr_le_to_str(addr, dev, sizeof(dev));
        printk("[DEVICE]: %s, AD evt type %u, AD data len %u, RSSI %i\n",
               dev, type, ad->len, rssi);

        /* We're only interested in connectable events */
        if (type == BT_GAP_ADV_TYPE_ADV_IND ||
            type == BT_GAP_ADV_TYPE_ADV_DIRECT_IND) {
                bt_data_parse(ad, eir_found, (void *)addr);
        }
}


static void adv_start(void)
{
	struct bt_le_adv_param *adv_param =
		BT_LE_ADV_PARAM(BT_LE_ADV_OPT_CONNECTABLE |
				BT_LE_ADV_OPT_ONE_TIME,
				BT_GAP_ADV_FAST_INT_MIN_2,
				BT_GAP_ADV_FAST_INT_MAX_2, NULL);
	int err;

	err = bt_le_adv_start(adv_param, ad, ARRAY_SIZE(ad), NULL,
			      0);
	
	if (err) {
		printk("Failed to start advertiser (%d)\n", err);
		return;
	}

	printk("Start advertising\n");

}


static void disconnected(struct bt_conn *conn, uint8_t reason)
{
	struct bt_conn_info info = {0};
	int err;

	printk("Disconnected (reason 0x%02x)\n", reason);

	test_ready = false;
	if (default_conn) {
		bt_conn_unref(default_conn);
		default_conn = NULL;
	}

	err = bt_conn_get_info(conn, &info);
	if (err) {
		printk("Failed to get connection info (%d)\n", err);
		return;
	}

	/* Re-connect using same roles */
	if (info.role != BT_CONN_ROLE_MASTER) {
		adv_start();
	}
}

static uint8_t throughput_read(const struct bt_gatt_throughput_metrics *met)
{
	printk("[peer] received %u bytes (%u KB)"
	       " in %u GATT writes at %u bps\n",
	       met->write_len, met->write_len / 1024, met->write_count,
	       met->write_rate);

	test_ready = true;

	return BT_GATT_ITER_STOP;
}

static void throughput_received(const struct bt_gatt_throughput_metrics *met)
{
	static uint32_t kb;

	if (met->write_len == 0) {
		kb = 0;
		printk("\n");

		return;
	}

	if ((met->write_len / 1024) != kb) {
		kb = (met->write_len / 1024);
		printk("=");
	}
}

static void throughput_send(const struct bt_gatt_throughput_metrics *met)
{
	printk("\n[local] received %u bytes (%u KB)"
		" in %u GATT writes at %u bps\n",
		met->write_len, met->write_len / 1024,
		met->write_count, met->write_rate);
}

static const struct bt_gatt_throughput_cb throughput_cb = {
	.data_read = throughput_read,
	.data_received = throughput_received,
	.data_send = throughput_send
};

static void test_run(void)
{
	int err;
	uint64_t stamp;
	uint32_t delta;
	uint32_t data = 0;
	uint32_t prog = 0;

	/* a dummy data buffer */
	static char dummy[256];


	/* wait for user input to continue */

	if (!test_ready) {
		/* disconnected while blocking inside _getchar() */
		return;
	}

	test_ready = false;

	if(start_flag == true){
		data = 0;
		prog = 0;
		/* reset peer metrics */
		err = bt_gatt_throughput_write(&gatt_throughput, dummy, 1);
		if (err) {
			printk("Reset peer metrics failed.\n");
			return;
		}

		/* get cycle stamp */
		stamp = k_uptime_get_32();
		uint64_t stamp2;
		int app_th = 176;
		int data2 = 0;
		/*BLEX: By changing packet interval, we can change the traffic size*/
		int break_time = 110*8/app_th;
		int packet_size = 110;
		while (k_uptime_get_32()-stamp < 60000) {
			err = bt_gatt_throughput_write(&gatt_throughput, dummy, packet_size);
			if (err) {
				printk("GATT write failed (err %d)\n", err);
				break;
			}
			while(k_uptime_get_32()-stamp2 <break_time) ;
			data += packet_size;
			prog++;
			data2 += packet_size;
			if(prog %1000 == 0) {
				uint32_t delta2 = k_uptime_get_32()-stamp2;
				printk("[local] sent %u bytes (%u KB) in %u ms at %llu kbps\n",
						data2, data2 / 1024, delta2, ((uint64_t)data2 * 8 / delta2));
				stamp2 = k_uptime_get_32();
				data2 = 0;
			}
		}
		delta = k_uptime_delta_32(&stamp);

		printk("\nDone\n");
		printk("[local] sent %u bytes (%u KB) in %u ms at %llu kbps\n",
				data, data / 1024, delta, ((uint64_t)data * 8 / delta));

		/* read back char from peer */
		err = bt_gatt_throughput_read(&gatt_throughput);
		if (err) {
			printk("GATT read failed (err %d)\n", err);
		}
	}
	else{

		/* reset peer metrics */
		err = bt_gatt_throughput_write(&gatt_throughput, dummy, 1);
		if (err) {
			printk("Reset peer metrics failed.\n");
			return;
		}

		/* get cycle stamp */
		stamp = k_uptime_get_32();

		data = 0;
		prog = 0;
		int temp_delta = 20;
		uint64_t stamp2;
		int app_th = 176;
		int packet_size = 110;
		/*BLEX: By changing packet interval, we can change the traffic size*/
		int break_time = packet_size*8/app_th;
		uint64_t stamp3;
		int data2 =0;
		stamp2 = k_uptime_get_32();
		while (k_uptime_get_32()-stamp < 6000000000) {
			stamp3 = k_uptime_get_32();
			err = bt_gatt_throughput_write(&gatt_throughput, dummy, packet_size);
			if (err) {
				printk("GATT write failed (err %d)\n", err);
				break;
			}
			while(k_uptime_get_32()-stamp3 <break_time) ;
			data += packet_size;
			prog++;
			data2+=packet_size;
			if(prog %1000 == 0) {

				uint32_t delta2 = k_uptime_get_32()-stamp2;
				printk("[local] sent %u bytes (%u KB) in %u ms at %llu kbps\n",
						data2, data2 / 1024, delta2, ((uint64_t)data2 * 8 / delta2));
				stamp2 = k_uptime_get_32();
				data2= 0;
			}

		}

		delta = k_uptime_delta_32(&stamp);

		printk("\nDone\n");
		printk("[local] sent %u bytes (%u KB) in %u ms at %llu kbps\n",
				data, data / 1024, delta, ((uint64_t)data * 8 / delta));

		/* read back char from peer */
		err = bt_gatt_throughput_read(&gatt_throughput);
		if (err) {
			printk("GATT read failed (err %d)\n", err);
		}
	}
	if(start_flag == true) start_flag = false;
	else 
		start_flag = true;

}

static bool le_param_req(struct bt_conn *conn, struct bt_le_conn_param *param)
{
	/* reject peer conn param request */
	return true;
}

static void auth_cancel(struct bt_conn *conn)
{
	char addr[BT_ADDR_LE_STR_LEN];

	bt_addr_le_to_str(bt_conn_get_dst(conn), addr, sizeof(addr));

	printk("Pairing cancelled: %s\n", addr);
}

static struct bt_conn_auth_cb auth_cb_display = {
	.cancel = auth_cancel,
};

void main(void)
{
	int err;

	uint16_t offset;

	static struct bt_conn_cb conn_callbacks = {
		.connected = connected,
		.disconnected = disconnected,
		.le_param_req = le_param_req,
	};

	printk("Starting Bluetooth Throughput example\n");

	console_init();

	bt_conn_cb_register(&conn_callbacks);
	bt_conn_auth_cb_register(&auth_cb_display);

	err = bt_enable(NULL);
	if (err) {
		printk("Bluetooth init failed (err %d)\n", err);
		return;
	}

	printk("Bluetooth initialized\n");

	err = bt_gatt_throughput_init(&gatt_throughput, &throughput_cb);
	if (err) {
		printk("Throughput service initialization failed.\n");
		return;
	}

	adv_start();

	for (;;) {
		if (test_ready) {
			test_run();
		}
	}
}
```

## src/throughput.c
```c
/*
 * Copyright (c) 2018 Nordic Semiconductor ASA
 *
 * SPDX-License-Identifier: LicenseRef-BSD-5-Clause-Nordic
 */

#include <kernel.h>
#include <sys/printk.h>
#include <string.h>
#include <zephyr/types.h>

#include <bluetooth/bluetooth.h>
#include <bluetooth/conn.h>
#include <bluetooth/gatt.h>
#include <bluetooth/hci.h>
#include <bluetooth/uuid.h>

#include "throughput.h"

#include <logging/log.h>

LOG_MODULE_REGISTER(bt_gatt_throughput, LOG_LEVEL_DBG);

static struct bt_gatt_throughput_metrics met;
static const struct bt_gatt_throughput_cb *callbacks;

static uint8_t read_fn(struct bt_conn *conn, uint8_t err,
		    struct bt_gatt_read_params *params, const void *data,
		    uint16_t len)
{
	struct bt_gatt_throughput_metrics metrics;

	memset(&metrics, 0, sizeof(struct bt_gatt_throughput_metrics));

	if (data) {
		len = MIN(len, sizeof(struct bt_gatt_throughput_metrics));
		memcpy(&metrics, data, len);

		if (callbacks->data_read) {
			return callbacks->data_read(&metrics);
		}
	}

	return BT_GATT_ITER_STOP;
}

static ssize_t write_callback(struct bt_conn *conn,
			      const struct bt_gatt_attr *attr, const void *buf,
			      uint16_t len, uint16_t offset, uint8_t flags)
{
	static uint32_t clock_cycles;
	static uint32_t kb;

	uint64_t delta;

	struct bt_gatt_throughput_metrics *met_data = attr->user_data;

	delta = k_cycle_get_32() - clock_cycles;
	delta = k_cyc_to_ns_floor64(delta);

	if (len == 1) {
		/* reset metrics */
		kb = 0;
		met_data->write_count = 0;
		met_data->write_len = 0;
		met_data->write_rate = 0;
		clock_cycles = k_cycle_get_32();
	} else {
		met_data->write_count++;
		met_data->write_len += len;
		met_data->write_rate =
		    ((uint64_t)met_data->write_len << 3) * 1000000000 / delta;
	}

	LOG_DBG("Received data.");

	if (callbacks->data_received) {
		callbacks->data_received(met_data);
	}

	return len;
}

static ssize_t read_callback(struct bt_conn *conn,
			     const struct bt_gatt_attr *attr, void *buf,
			     uint16_t len, uint16_t offset)
{
	const struct bt_gatt_throughput_metrics *metrics = attr->user_data;

	len = MIN(sizeof(struct bt_gatt_throughput_metrics), len);

	if (callbacks->data_send) {
		callbacks->data_send(metrics);
	}

	LOG_DBG("Data send.");

	return bt_gatt_attr_read(
		conn, attr, buf, len, offset, attr->user_data, len);
}


BT_GATT_SERVICE_DEFINE(throughput_svc,
BT_GATT_PRIMARY_SERVICE(BT_UUID_THROUGHPUT),
	BT_GATT_CHARACTERISTIC(BT_UUID_THROUGHPUT_CHAR,
		BT_GATT_CHRC_READ | BT_GATT_CHRC_WRITE_WITHOUT_RESP,
		BT_GATT_PERM_READ | BT_GATT_PERM_WRITE,
		read_callback, write_callback, &met),
);

int bt_gatt_throughput_init(struct bt_gatt_throughput *throughput,
			    const struct bt_gatt_throughput_cb *cb)
{
	if (!throughput || !cb) {
		return -EINVAL;
	}

	callbacks = cb;

	return 0;
}

int bt_gatt_throughput_handles_assign(struct bt_gatt_dm *dm,
				      struct bt_gatt_throughput *throughput)
{
	const struct bt_gatt_dm_attr *gatt_service_attr =
			bt_gatt_dm_service_get(dm);
	const struct bt_gatt_service_val *gatt_service =
			bt_gatt_dm_attr_service_val(gatt_service_attr);
	const struct bt_gatt_dm_attr *gatt_chrc;
	const struct bt_gatt_dm_attr *gatt_desc;

	if (bt_uuid_cmp(gatt_service->uuid, BT_UUID_THROUGHPUT)) {
		return -ENOTSUP;
	}

	LOG_DBG("Getting handles from Throughput service.");

	/* Throughput Characteristic. */
	gatt_chrc = bt_gatt_dm_char_by_uuid(dm, BT_UUID_THROUGHPUT_CHAR);
	if (!gatt_chrc) {
		LOG_ERR("Missing Throughput characteristic.");
	}

	gatt_desc = bt_gatt_dm_desc_by_uuid(dm, gatt_chrc,
					    BT_UUID_THROUGHPUT_CHAR);
	if (!gatt_desc) {
		LOG_ERR("Missing Throughput characteristic value descriptor");
		return -EINVAL;
	}

	LOG_DBG("Found handle for Throughput characteristic.");
	throughput->char_handle = gatt_desc->handle;

	/* Assign connection object. */
	throughput->conn = bt_gatt_dm_conn_get(dm);
	return 0;
}

int bt_gatt_throughput_read(struct bt_gatt_throughput *throughput)
{
	int err;

	throughput->read_params.single.handle = throughput->char_handle;
	throughput->read_params.single.offset = 0;
	throughput->read_params.handle_count = 1;
	throughput->read_params.func = read_fn;

	err = bt_gatt_read(throughput->conn, &throughput->read_params);
	if (err) {
		LOG_ERR("Characteristic read failed.");
	}

	return err;
}

int bt_gatt_throughput_write(struct bt_gatt_throughput *throughput,
			     const uint8_t *data, uint16_t len)
{
	return bt_gatt_write_without_response(throughput->conn,
					      throughput->char_handle,
					      data, len, false);
}
```

## src/throughput.h
```c
/*
 * Copyright (c) 2018 Nordic Semiconductor ASA
 *
 * SPDX-License-Identifier: LicenseRef-BSD-5-Clause-Nordic
 */

/**
 * @file
 * @defgroup bt_gatt_throughput BLE GATT Throughput Service API
 * @{
 * @brief API for the BLE GATT Throughput Service.
 */

#ifndef BT_GATT_THROUGHPUT_H_
#define BT_GATT_THROUGHPUT_H_

#include <bluetooth/uuid.h>
#include <bluetooth/conn.h>
#include "gatt_dm.h"

#ifdef __cplusplus
extern "C" {
#endif

/** @brief Throughput metrics. */
struct bt_gatt_throughput_metrics {

        /** Number of GATT writes received. */
	uint32_t write_count;

        /** Number of bytes received. */
	uint32_t write_len;

        /** Transfer speed in bits per second. */
	uint32_t write_rate;
};

/** @brief Throughput callback structure. */
struct bt_gatt_throughput_cb {
	/** @brief Data read callback.
	 *
	 * This function is called when data has been read from the
	 * Throughput Characteristic.
	 *
	 * @param[in] met Throughput metrics.
	 *
	 * @retval BT_GATT_ITER_CONTINUE To keep notifications enabled.
	 * @retval BT_GATT_ITER_STOP To disable notifications.
	 */
	uint8_t (*data_read)(const struct bt_gatt_throughput_metrics *met);

	/** @brief Data received callback.
	 *
	 * This function is called when data has been received by the
	 * Throughput Characteristic.
	 *
	 * @param[in] met Throughput metrics.
	 */
	void (*data_received)(const struct bt_gatt_throughput_metrics *met);

	/** @brief Data send callback.
	 *
	 * This function is called when data has been sent to the
	 * Throughput Characteristic.
	 *
	 * @param[in] met Throughput metrics.
	 */
	void (*data_send)(const struct bt_gatt_throughput_metrics *met);
};

/** @brief Throughput structure. */
struct bt_gatt_throughput {
	/** Throughput Characteristic handle. */
	uint16_t char_handle;

	/** GATT read parameters for the Throughput Characteristic. */
	struct bt_gatt_read_params read_params;

	/** Throughput callback structure. */
	struct bt_gatt_throughput_cb *cb;

	/** Connection object. */
	struct bt_conn *conn;
};

/** @brief Throughput Characteristic UUID. */
#define BT_UUID_THROUGHPUT_CHAR BT_UUID_DECLARE_16(0x1524)

/** @brief Throughput Service UUID. */
#define BT_UUID_THROUGHPUT                                                     \
	BT_UUID_DECLARE_128(0xBB, 0x4A, 0xFF, 0x4F, 0xAD, 0x03, 0x41, 0x5D,    \
			    0xA9, 0x6C, 0x9D, 0x6C, 0xDD, 0xDA, 0x83, 0x04)

/** @brief Initialize the GATT Throughput Service.
 *
 *  @param[in] throughput Throughput Service instance.
 *  @param[in] cb Callbacks.
 *
 *  @retval 0 If the operation was successful.
 *            Otherwise, a negative error code is returned.
 */
int bt_gatt_throughput_init(struct bt_gatt_throughput *throughput,
			    const struct bt_gatt_throughput_cb *cb);

/** @brief Assign handles to the Throughput Service instance.
 *
 * This function should be called when a link with a peer has been established,
 * to associate the link to this instance of the module. This makes it
 * possible to handle several links and associate each link to a particular
 * instance of this module. The GATT attribute handles are provided by the
 * GATT Discovery Manager.
 *
 * @param[in] dm Discovery object.
 * @param[in,out] throughput Throughput Service instance.
 *
 * @retval 0 If the operation was successful.
 *           Otherwise, a negative error code is returned.
 * @retval (-ENOTSUP) Special error code used when the UUID
 *         of the service does not match the expected UUID.
 */
int bt_gatt_throughput_handles_assign(struct bt_gatt_dm *dm,
				      struct bt_gatt_throughput *throughput);

/** @brief Read data from the server.
 *
 *  @note This procedure is asynchronous.
 *
 *  @param[in] throughput Throughput Service instance.
 *
 *  @retval 0 If the operation was successful.
 *            Otherwise, a negative error code is returned.
 */
int bt_gatt_throughput_read(struct bt_gatt_throughput *throughput);

/** @brief Write data to the server.
 *
 *  @param[in] throughput Throughput Service instance.
 *  @param[in] data Data.
 *  @param[in] len Data length.
 *
 *  @retval 0 If the operation was successful.
 *            Otherwise, a negative error code is returned.
 */
int bt_gatt_throughput_write(struct bt_gatt_throughput *throughput,
			     const uint8_t *data, uint16_t len);

#ifdef __cplusplus
}
#endif

/**
 * @}
 */

#endif /* BT_GATT_THROUGHPUT_H_ */
```
